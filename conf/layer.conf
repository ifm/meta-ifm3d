## conf/layer.conf
```bitbake
# We have a conf and classes directory, add to BBPATH
BBPATH := "${BBPATH}:${LAYERDIR}"

# We have a recipes directory, add to BBFILES
BBFILES := "${BBFILES} ${LAYERDIR}/recipes-*/*/*.bb \
	${LAYERDIR}/recipes-*/*/*.bbappend"

BBFILE_COLLECTIONS += "ifm3d"
BBFILE_PATTERN_ifm3d := "^${LAYERDIR}/"
BBFILE_PRIORITY_ifm3d = "6"

LAYERSERIES_COMPAT_ifm3d = "sumo"


# glog,xmlrpc-c,opencv and pcl is retrieved from meta-oe
LAYERDEPENDS_ifm-layer = "oe"
```
